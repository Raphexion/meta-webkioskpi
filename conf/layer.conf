## conf/layer.conf
```bitbake
# We have a conf and classes directory, add to BBPATH
BBPATH .= ":${LAYERDIR}"

# We have recipes-* directories, add to BBFILES
BBFILES += "${LAYERDIR}/recipes-*/*/*.bb \
            ${LAYERDIR}/recipes-*/*/*.bbappend"

BBFILE_COLLECTIONS += "meta-webkioskpi"
BBFILE_PATTERN_meta-webkioskpi = "^${LAYERDIR}/"
BBFILE_PRIORITY_meta-webkioskpi = "6"

LAYERDEPENDS_meta-webkioskpi = "core"
LAYERSERIES_COMPAT_meta-webkioskpi = "dunfell"
```
